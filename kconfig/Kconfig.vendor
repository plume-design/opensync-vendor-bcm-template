## kconfig/Kconfig.vendor
```kconfig
menuconfig VENDOR_IS_BCM_TEMPLATE
    bool "BCM template"
    help
        OpenSync template vendor layer for BCM devices.
```

## src/lib/osp/kconfig/Kconfig.osp_unit.backend
```kconfig
config OSP_UNIT_BCM_TEMPLATE
    bool "BCM template Plume hardware example"
    help
        Example of OSP unit API implementation used by Plume hardware based
        targets from bcm-template vendor layer.

if OSP_UNIT_BCM_TEMPLATE
    config OSP_UNIT_BCM_TEMPLATE_SERIAL_PREFIX
        string "Unit serial number prefix"
        default "OSx"
endif
```
